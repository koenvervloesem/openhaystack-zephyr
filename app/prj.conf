## CMakeLists.txt
```
cmake_minimum_required(VERSION 3.13.1)

# Find OpenHaystack module
list(APPEND ZEPHYR_EXTRA_MODULES ${CMAKE_CURRENT_SOURCE_DIR}/../modules/openhaystack)

# Find Zephyr. This also loads Zephyr's build system.
find_package(Zephyr REQUIRED HINTS $ENV{ZEPHYR_BASE})

project(openhaystack-firmware)

# Source files to the "app" target
target_sources(app PRIVATE src/main.c)
if(CONFIG_USB_UART_CONSOLE)
  target_sources(app PRIVATE src/debug.c)
endif()
```

## prj.conf
```kconfig
# Enable Bluetooth and allow a second Bluetooth identity for the OpenHaystack library
CONFIG_BT=y
CONFIG_BT_ID_MAX=2

# Enable OpenHaystack module
CONFIG_OPENHAYSTACK=y
```

## debug-usb-uart.conf
```kconfig
# This is a Kconfig fragment which can be used to enable debug-related options
# in the application. See the README for more details.

# Bluetooth debug log
CONFIG_BT_DEBUG_LOG=y

# Debugging via USB UART
CONFIG_USB=y
CONFIG_USB_UART_CONSOLE=y
CONFIG_UART_LINE_CTRL=y
CONFIG_UART_CONSOLE_ON_DEV_NAME="CDC_ACM_0"
```

## src/main.c
```c
/*
 * OpenHaystack Zephyr firmware - Track your personal Bluetooth devices via
 * Apple's Find My network
 *
 * Copyright (c) 2021 Koen Vervloesem <koen@vervloesem.eu>
 *
 * SPDX-License-Identifier: MIT
 */

#include <bluetooth/addr.h>
#include <bluetooth/bluetooth.h>
#include <bluetooth/hci.h>
#include <stddef.h>
#include <sys/printk.h>
#include <sys/util.h>
#include <zephyr/types.h>

#include "openhaystack.h"

#ifdef CONFIG_USB_UART_CONSOLE
#include "debug.h"
#endif

// Don't make `const`, so we can replace the key in the compiled bin file
static char public_key[28] = "OFFLINEFINDINGPUBLICKEYHERE!";

static bt_addr_le_t device_address = { BT_ADDR_LE_RANDOM,
				       { 0xFF, 0xBB, 0xCC, 0xDD, 0xEE, 0xFF } };

void main(void)
{
	int err, bt_id;

	printk("Starting OpenHaystack firmware...\n");

	// Set advertisement data
	of_set_manufacturer_data_from_key(of_manufacturer_data, public_key);

	// Set default address
	of_set_address_from_key(&device_address, public_key);
	bt_id = bt_id_create(&device_address, NULL);
	if (bt_id < 0) {
		printk("Can't create new identity (err %d)\n", bt_id);
		return;
	} else {
		printk("Created new identity %d\n", bt_id);
	}

	// Initialize the Bluetooth subsystem
	err = bt_enable(NULL);
	if (err) {
		printk("Bluetooth init failed (err %d)\n", err);
	}

	printk("Bluetooth initialized\n");

	// Start advertising
	of_adv_param.id = 0;
	err = bt_le_adv_start(&of_adv_param, of_advertising_data, ARRAY_SIZE(of_advertising_data), NULL, 0);
	if (err) {
		printk("Advertising failed to start (err %d)\n", err);
		return;
	}

}

#ifdef CONFIG_USB_UART_CONSOLE
// Task for starting up the USB console
K_THREAD_DEFINE(console_id, STACKSIZE, console_init, NULL, NULL, NULL, PRIORITY - 2, 0, 0);
#endif
```

## src/debug.c
```c
/*
 * OpenHaystack Zephyr firmware - Track your personal Bluetooth devices via
 * Apple's Find My network
 *
 * Copyright (c) 2021 Koen Vervloesem <koen@vervloesem.eu>
 *
 * SPDX-License-Identifier: MIT
 */

#include "debug.h"

void console_init(void)
{
	struct device *dev = device_get_binding(CONFIG_UART_CONSOLE_ON_DEV_NAME);
	uint32_t dtr = 0;

	if (usb_enable(NULL)) {
		return;
	}

	/* Poll if the DTR flag was set, optional */
	while (!dtr) {
		uart_line_ctrl_get(dev, UART_LINE_CTRL_DTR, &dtr);
		k_msleep(250); // Let other tasks run if no terminal is connected to USB
	}

	if (strlen(CONFIG_UART_CONSOLE_ON_DEV_NAME) != strlen("CDC_ACM_0") ||
	    strncmp(CONFIG_UART_CONSOLE_ON_DEV_NAME, "CDC_ACM_0",   strlen(CONFIG_UART_CONSOLE_ON_DEV_NAME))) {
		printk("Error: Console device name is not USB ACM\n");

		return;
	}

	while (1) {
		k_msleep(20000);
	}
}
```

## src/debug.h
```c
/*
 * OpenHaystack Zephyr firmware - Track your personal Bluetooth devices via
 * Apple's Find My network
 *
 * Copyright (c) 2021 Koen Vervloesem <koen@vervloesem.eu>
 *
 * SPDX-License-Identifier: MIT
 */

#ifndef _DEBUG_H_
#define _DEBUG_H_

#include <drivers/uart.h>
#include <usb/usb_device.h>

// Size of stack area used by each thread
#define STACKSIZE 1024

// Scheduling priority used by each thread
#define PRIORITY 7

void console_init(void);

#endif /* _DEBUG_H_ */
```
