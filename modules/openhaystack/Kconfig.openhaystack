## modules/openhaystack/Kconfig.openhaystack
```kconfig
config OPENHAYSTACK
	bool "OpenHaystack support"
	default n
	help
	  Enable the OpenHaystack library
```

## west.yml
```yaml
manifest:
  self:
    path: openhaystack-zephyr
  remotes:
    - name: zephyrproject-rtos
      url-base: https://github.com/zephyrproject-rtos
  projects:
    - name: zephyr
      remote: zephyrproject-rtos
      revision: v2.6.0
      import: true
```
